## packages/artinchip/mpp/Kconfig
```kconfig
menuconfig LPKG_MPP
    bool "aic-mpp"
    default y

config AIC_MPP_PLAYER_INTERFACE
    bool "Enable player interface and demo"
    default n
    depends on LPKG_MPP
    select LPKG_USING_MAD
    select AIC_AUDIO_DRV
    select RT_USING_PTHREADS

config AIC_MPP_PLAYER_VE_USE_FILL_FB
    bool "Enable player ve use fill fb"
    default n
    depends on LPKG_MPP && AIC_MPP_PLAYER_INTERFACE

config AIC_MPP_AVI_DEMUX
    bool "Enable avi demux"
    default n
    depends on LPKG_MPP && AIC_MPP_PLAYER_INTERFACE

config AIC_MPP_FLAC_DEMUX
    bool "Enable flac demux"
    default n
    depends on LPKG_MPP && AIC_MPP_PLAYER_INTERFACE && LPKG_USING_LIBFLAC

config AIC_MPP_RECORDER_INTERFACE
    bool "Enable recorder interface and demo"
    default n
    depends on LPKG_MPP
    select LPKG_USING_MAD
    select AIC_AUDIO_DRV
    select RT_USING_PTHREADS

config AIC_MPP_VIN
    bool "Enable Video Input interface"
    default n
    depends on LPKG_MPP

config AIC_MPP_VIN_DEV
    bool "Enable Video Input interface of DevMode"
    default n
    depends on LPKG_MPP && !AIC_MPP_VIN && AIC_USING_DE

config AIC_MPP_VIN_BUF_SIZE
    int "Size of Video Input buffer"
    default 1843264
    depends on LPKG_MPP && (AIC_MPP_VIN || AIC_MPP_VIN_DEV)

config AIC_MPP_FB_TEST
    bool "Install MPP FB test programs"
    default n
    depends on LPKG_MPP

config AIC_STARTUP_UI_SHOW
    bool "Show Startup Ui"
    default n
    depends on LPKG_MPP

if AIC_STARTUP_UI_SHOW
    config AIC_STARTUP_UI_POS_X
        int "X coordinate of the screen in pixels"
        default 86
    config AIC_STARTUP_UI_POS_Y
        int "Y coordinate of the screen in pixels"
        default 60
endif

config AIC_MPP_AICP_DEC_ENABLE
    bool "enable aic picture decoder"
    default n
    depends on LPKG_MPP
```
