## Kconfig
```kconfig
mainmenu "ArtInChip Luban-Lite SDK Configuration"

menu "Project options"

config PRJ_DEFCONFIG_FILENAME
    string "Project defconfig file name"

comment "-- Important: If following options have been changed, you need save & rerun menuconfig before changing any other options."

config PRJ_CHIP
    string "Chip name"
    #option env="PRJ_CHIP"
    # Don't set default value to make defconfig contain CONFIG_PRJ_CHIP option

config PRJ_BOARD
    string "Board name"
    #option env="PRJ_BOARD"

config PRJ_KERNEL
    string "Kernel name"
    #option env="PRJ_KERNEL"

config PRJ_APP
    string "Application name"
    #option env="PRJ_APP"

choice
    prompt "Toolchain"
    depends on ARCH_RISCV
    default PRJ_RV_TOOLCHAIN_V2_6_1

    config PRJ_RV_TOOLCHAIN_V2_6_1
        bool "RISC-V Toolchain V2.6.1"
    config PRJ_RV_TOOLCHAIN_V3_2_0
        bool "RISC-V Toolchain V3.2.0"
endchoice

config PRJ_TOOLCHAIN_VER
    string
    default "V2.6.1" if PRJ_RV_TOOLCHAIN_V2_6_1
    default "V3.2.0" if PRJ_RV_TOOLCHAIN_V3_2_0

endmenu

config PLATFORM_LUBANLITE
    bool
    default y

config PKGS_DIR
    string
    default "tools/env/packages"
	help
        packages directory for RT-Thread online packages

if ! AIC_BOOTLOADER
source "application/Kconfig"
endif
source ".Kconfig.prj"
source "packages/Kconfig"
source "bsp/Kconfig"
```

## packages/third-party/librws/Kconfig
```kconfig
menuconfig PKG_USING_LIBRWS
    bool "Enable librws websocket client"
    default n
if PKG_USING_LIBRWS
    choice
        prompt "Select TLS support"
        default PKG_LIBRWS_MBEDTLS
        config PKG_LIBRWS_MBEDTLS
            bool "mbedTLS"
            #select PKG_USING_MBEDTLS
        config PKG_LIBRWS_NO_TLS
            bool "No TLS support"
    endchoice

    config LIBRWS_USING_EXAMPLE
        bool "Enable example"
        default n
endif
```

## target/configs/d12p_d126-demo124-mmc_baremetal_bootloader_defconfig
```kconfig
CONFIG_PRJ_DEFCONFIG_FILENAME="d12p_d126-demo124-mmc_baremetal_bootloader_defconfig"
CONFIG_PRJ_CHIP="d12p"
CONFIG_PRJ_BOARD="d126-demo124-mmc"
CONFIG_PRJ_KERNEL="baremetal"
CONFIG_PRJ_APP="bootloader"
CONFIG_PRJ_CUSTOM_LDS="application/baremetal/bootloader/ldscript/d12p_bootloader_gcc.ld"
CONFIG_AIC_USING_UART0=y
CONFIG_AIC_USING_SDMC0=y
# CONFIG_AIC_USING_GE is not set
# CONFIG_AIC_USING_VE is not set
CONFIG_AIC_USING_WRI=y
CONFIG_AIC_USING_RTC=y
CONFIG_AIC_USING_WDT=y
CONFIG_AIC_PSRAM_SW_SIZE=0x300000
CONFIG_AIC_INTERRUPTSTACK_SIZE=8192
CONFIG_AIC_SYSCFG_LDO1X_ENABLE=y
CONFIG_AIC_NORMALSTACK_SIZE=8192
CONFIG_AIC_BOOTLOADER_TEXT_SIZE=0x7FF00
# CONFIG_AIC_BOOTLOADER_SPINOR_SUPPORT is not set
# CONFIG_AIC_BOOTLOADER_SPINAND_SUPPORT is not set
CONFIG_AICUPG_SDCARD_ENABLE=y
CONFIG_AICUPG_SDCARD_CONTROLLER_ID=0
CONFIG_AICUPG_MMC_ARTINCHIP=y
# CONFIG_AICUPG_LOG_BUFFER_SUPPORT is not set
CONFIG_AIC_BOOTLOADER_CMD_MMC_BOOT=y
CONFIG_AIC_BOOTLOADER_CMD_PART=y
CONFIG_LPKG_CHERRYUSB_DEVICE_CLASS_AIC_SINGLE=y
# CONFIG_LPKG_MPP is not set
CONFIG_AIC_MMC_BARE_TEST=y
```

## target/configs/d12p_d126-demo124-mmc_rt-thread_helloworld_defconfig
```kconfig
CONFIG_PRJ_DEFCONFIG_FILENAME="d12p_d126-demo124-mmc_rt-thread_helloworld_defconfig"
CONFIG_PRJ_CHIP="d12p"
CONFIG_PRJ_BOARD="d126-demo124-mmc"
CONFIG_PRJ_KERNEL="rt-thread"
CONFIG_PRJ_APP="helloworld"
CONFIG_AIC_USING_UART0=y
CONFIG_AIC_USING_SDMC0=y
CONFIG_AIC_SDMC_IRQ_MODE=y
CONFIG_AIC_SDMC1_CLK_FREQ=40000000
CONFIG_AIC_WIRELESS_LAN=y
CONFIG_AIC_WIRELESS_PWR_GPIO="PE.18"
CONFIG_AIC_WIRELESS_BT_PWR_GPIO="PE.20"
CONFIG_AIC_WLAN_AIC8800D40L=y
CONFIG_CHIP_SELECT_AIC8800DL=y
# CONFIG_AIC_USING_DE is not set
# CONFIG_AIC_USING_GE is not set
# CONFIG_AIC_USING_VE is not set
CONFIG_AIC_USING_DMA=y
CONFIG_AIC_USING_WRI=y
CONFIG_AIC_USING_RTC=y
CONFIG_AIC_USING_WDT=y
CONFIG_AIC_PSRAM_SW_SIZE=0x200000
CONFIG_AIC_INTERRUPTSTACK_SIZE=4096
CONFIG_AIC_USING_SID=y
CONFIG_AIC_SYSCFG_LDO1X_ENABLE=y
CONFIG_RT_NAME_MAX=8
CONFIG_IDLE_THREAD_STACK_SIZE=1024
CONFIG_RT_TIMER_THREAD_PRIO=7
CONFIG_RT_TIMER_THREAD_STACK_SIZE=8192
# CONFIG_RT_KSERVICE_USING_STDLIB is not set
# CONFIG_RT_DEBUG is not set
CONFIG_RT_MEMHEAP_BSET_MODE=y
CONFIG_RT_USING_MEMHEAP_AS_HEAP=y
# CONFIG_RT_USING_MEMHEAP_AUTO_BINDING is not set
CONFIG_RT_USING_MEMTRACE=y
CONFIG_RT_CONSOLE_DEVICE_NAME="uart0"
CONFIG_RT_MAIN_THREAD_STACK_SIZE=8192
CONFIG_RT_USING_LEGACY=y
CONFIG_FINSH_HISTORY_LINES=1
CONFIG_DFS_FILESYSTEMS_MAX=8
CONFIG_RT_USING_DFS_MNTTABLE=y
CONFIG_RT_USING_DFS_ELMFAT=y
CONFIG_RT_DFS_ELM_LFN_UNICODE_2=y
CONFIG_RT_DFS_ELM_USE_EXFAT=y
CONFIG_RT_DFS_ELM_DRIVES=4
CONFIG_RT_DFS_ELM_MAX_SECTOR_SIZE=4096
CONFIG_RT_USING_DFS_ROMFS=y
CONFIG_RT_USING_SYSTEM_WORKQUEUE=y
CONFIG_RT_SYSTEM_WORKQUEUE_STACKSIZE=8192
CONFIG_RT_USING_I2C=y
CONFIG_RT_USING_ADC=y
CONFIG_RT_SDIO_STACK_SIZE=16384
CONFIG_RT_SDIO_THREAD_PRIORITY=5
CONFIG_RT_MMCSD_STACK_SIZE=8192
CONFIG_RT_USING_SPI=y
CONFIG_RT_USING_SFUD=y
CONFIG_RT_SFUD_USING_QSPI=y
CONFIG_RT_USING_AUDIO=y
CONFIG_RT_USING_SENSOR=y
CONFIG_RT_USING_TOUCH=y
CONFIG_RT_TOUCH_PIN_IRQ=y
CONFIG_RT_USING_WIFI=y
CONFIG_RT_WLAN_WORKQUEUE_THREAD_SIZE=8192
CONFIG_RT_WLAN_DEBUG=y
CONFIG_RT_WLAN_CMD_DEBUG=y
CONFIG_RT_USING_POSIX_FS=y
CONFIG_RT_USING_PTHREADS=y
CONFIG_RT_USING_CPLUSPLUS=y
CONFIG_RT_USING_NETDEV=y
CONFIG_RT_LWIP_TCPTHREAD_PRIORITY=3
CONFIG_RT_LWIP_TCPTHREAD_STACKSIZE=8192
CONFIG_RT_LWIP_NETIF_LOOPBACK=y
CONFIG_RT_USING_ULOG=y
CONFIG_ULOG_OUTPUT_LVL_I=y
CONFIG_ULOG_TIME_USING_TIMESTAMP=y
CONFIG_LPKG_USING_CPU_USAGE=y
CONFIG_LPKG_USING_LITTLEFS=y
CONFIG_LPKG_USING_MHZ=y
CONFIG_LPKG_USING_NETUTILS=y
CONFIG_LPKG_NETUTILS_IPERF=y
# CONFIG_LPKG_MPP is not set
CONFIG_LPKG_USING_PINMUX_CHECHK=y
CONFIG_AIC_PINMUX_CHECK=y
CONFIG_AIC_GPIO_IRQ_DRV_EN=y
CONFIG_AIC_CMU_DRV_TEST=y
CONFIG_AIC_SDIO_MGR_TEST=y
```

## target/configs/d12p_d126-demo124-nor_rt-thread_five_disp_defconfig
```kconfig
CONFIG_PRJ_DEFCONFIG_FILENAME="d12p_d126-demo124-nor_rt-thread_five_disp_defconfig"
CONFIG_PRJ_CHIP="d12p"
CONFIG_PRJ_BOARD="d126-demo124-nor"
CONFIG_PRJ_KERNEL="rt-thread"
CONFIG_PRJ_APP="helloworld"
CONFIG_AIC_USING_FS_IMAGE_0=y
CONFIG_AIC_USING_FS_IMAGE_TYPE_FATFS_FOR_0=y
CONFIG_AIC_FS_IMAGE_DIR_0="rodata"
CONFIG_AIC_FS_IMAGE_NAME_0="rodata.fatfs"
CONFIG_LVGL_V_9=y
CONFIG_AIC_LVGL_DEMO=y
CONFIG_AIC_LVGL_FIVE_DISP_DEMO=y
CONFIG_LV_COLOR_DEPTH=16
CONFIG_LV_CACHE_IMG_NUM=32
CONFIG_LV_IMAGE_HEADER_CACHE_DEF_CNT=2
CONFIG_LV_SPI_BUS_WIDTH_4=y
CONFIG_AIC_USING_UART0=y
CONFIG_AIC_USING_I2C0=y
CONFIG_AIC_USING_I2C1=y
CONFIG_AIC_USING_QSPI0=y
CONFIG_AIC_USING_QSPI1=y
CONFIG_AIC_DEV_QSPI1_MAX_SRC_FREQ_HZ=400000000
CONFIG_AIC_USING_QSPI2=y
CONFIG_AIC_DEV_QSPI2_MAX_SRC_FREQ_HZ=400000000
CONFIG_AIC_QSPI2_BUS_WIDTH_4=y
CONFIG_AIC_USING_QSPI3=y
CONFIG_AIC_DEV_QSPI3_MAX_SRC_FREQ_HZ=400000000
CONFIG_AIC_QSPI3_BUS_SPI=y
CONFIG_AIC_USING_QSPI4=y
CONFIG_AIC_DEV_QSPI4_MAX_SRC_FREQ_HZ=400000000
CONFIG_AIC_QSPI4_BUS_SPI=y
CONFIG_AIC_USING_QSPI5=y
CONFIG_AIC_DEV_QSPI5_MAX_SRC_FREQ_HZ=400000000
CONFIG_AIC_QSPI5_BUS_SPI=y
CONFIG_AIC_QSPI0_DEVICE_SPINOR=y
CONFIG_AIC_USING_TSEN=y
CONFIG_AIC_USING_TSEN_CPU=y
CONFIG_AIC_DISP_MIPI_DBI=y
CONFIG_AICFB_RGB565=y
# CONFIG_AIC_DISP_BOOTUP_LOGO is not set
CONFIG_AIC_PANEL_DBI_ST77912=y
CONFIG_AIC_QSPI_IDMA=y
CONFIG_AIC_USING_DMA=y
CONFIG_AIC_USING_WRI=y
CONFIG_AIC_USING_RTC=y
CONFIG_AIC_USING_WDT=y
CONFIG_AIC_INTERRUPTSTACK_SIZE=4096
CONFIG_AIC_USING_SID=y
CONFIG_AIC_SYSCFG_LDO1X_ENABLE=y
CONFIG_AIC_USING_MTOP=y
CONFIG_RT_NAME_MAX=8
CONFIG_IDLE_THREAD_STACK_SIZE=1024
CONFIG_RT_TIMER_THREAD_PRIO=7
CONFIG_RT_TIMER_THREAD_STACK_SIZE=8192
# CONFIG_RT_KSERVICE_USING_STDLIB is not set
# CONFIG_RT_DEBUG is not set
CONFIG_RT_MEMHEAP_BSET_MODE=y
CONFIG_RT_USING_MEMHEAP_AS_HEAP=y
# CONFIG_RT_USING_MEMHEAP_AUTO_BINDING is not set
CONFIG_RT_USING_MEMTRACE=y
CONFIG_RT_CONSOLE_DEVICE_NAME="uart0"
CONFIG_RT_MAIN_THREAD_STACK_SIZE=8192
CONFIG_RT_USING_LEGACY=y
CONFIG_FINSH_HISTORY_LINES=1
CONFIG_RT_USING_DFS_MNTTABLE=y
CONFIG_RT_USING_DFS_ELMFAT=y
CONFIG_RT_DFS_ELM_LFN_UNICODE_2=y
CONFIG_RT_DFS_ELM_MAX_SECTOR_SIZE=4096
CONFIG_RT_USING_DFS_ROMFS=y
CONFIG_RT_USING_FAL=y
CONFIG_FAL_USING_SFUD_PORT=y
# CONFIG_FAL_BLK_DEVICE_RDONLY is not set
CONFIG_RT_USING_SYSTEM_WORKQUEUE=y
CONFIG_RT_SYSTEM_WORKQUEUE_STACKSIZE=8192
CONFIG_RT_SFUD_USING_QSPI=y
CONFIG_RT_USING_TOUCH=y
CONFIG_RT_TOUCH_PIN_IRQ=y
CONFIG_RT_USING_POSIX_FS=y
CONFIG_RT_USING_ULOG=y
CONFIG_ULOG_OUTPUT_LVL_I=y
CONFIG_ULOG_TIME_USING_TIMESTAMP=y
CONFIG_LPKG_USING_CPU_USAGE=y
CONFIG_LPKG_USING_LITTLEFS=y
CONFIG_AIC_MPP_PLAYER_INTERFACE=y
CONFIG_AIC_MPP_PLAYER_VIDEO_EXT_RENDER=y
CONFIG_AIC_GPIO_IRQ_DRV_EN=y
CONFIG_AIC_QSPI_DRV_TEST=y
```

## target/configs/d12p_demo88-nand_baremetal_bootloader_defconfig
```kconfig
CONFIG_PRJ_DEFCONFIG_FILENAME="d12p_demo88-nand_baremetal_bootloader_defconfig"
CONFIG_PRJ_CHIP="d12p"
CONFIG_PRJ_BOARD="demo88-nand"
CONFIG_PRJ_KERNEL="baremetal"
CONFIG_PRJ_APP="bootloader"
CONFIG_PRJ_CUSTOM_LDS="application/baremetal/bootloader/ldscript/d12p_bootloader_gcc.ld"
CONFIG_AIC_USING_UART0=y
CONFIG_AIC_USING_QSPI0=y
CONFIG_AIC_QSPI0_DEVICE_SPINAND=y
# CONFIG_AIC_USING_DE is not set
# CONFIG_AIC_USING_GE is not set
# CONFIG_AIC_USING_VE is not set
CONFIG_AIC_USING_WRI=y
CONFIG_AIC_USING_RTC=y
CONFIG_AIC_USING_WDT=y
CONFIG_AIC_PSRAM_SW_SIZE=0x300000
CONFIG_AIC_INTERRUPTSTACK_SIZE=8192
# CONFIG_AIC_USING_SYSCFG is not set
CONFIG_AIC_NORMALSTACK_SIZE=8192
CONFIG_AIC_BOOTLOADER_TEXT_SIZE=0x7FF00
# CONFIG_AIC_BOOTLOADER_SPINOR_SUPPORT is not set
CONFIG_AIC_BOOTLOADER_AXICFG_SUPPORT=y
CONFIG_AIC_AXICFG_PORT_DVP_EN=y
CONFIG_AIC_AXICFG_PORT_DVP_PRIO=10
CONFIG_AICUPG_SDCARD_ENABLE=y
CONFIG_AICUPG_NAND_ARTINCHIP=y
CONFIG_AICUPG_NAND_SPL_PT_VER_20=y
# CONFIG_AICUPG_LOG_BUFFER_SUPPORT is not set
CONFIG_AIC_BOOTLOADER_CMD_NAND_BOOT=y
CONFIG_AIC_BOOTLOADER_CMD_SPI_NAND=y
CONFIG_AIC_BOOTLOADER_CMD_MTD=y
CONFIG_LPKG_CHERRYUSB_DEVICE_CLASS_AIC_SINGLE=y
# CONFIG_LPKG_USING_MINIMP3 is not set
# CONFIG_LPKG_MPP is not set
# CONFIG_LPKG_USING_ENV is not set
CONFIG_SPI_NAND_DOSILICON=y
CONFIG_SPI_NAND_ETRON=y
CONFIG_SPI_NAND_ZETTA=y
CONFIG_SPI_NAND_ZBIT=y
CONFIG_AIC_NFTL_SUPPORT=y
```

## target/configs/d12p_demo88-nand_rt-thread_helloworld_defconfig
```kconfig
CONFIG_PRJ_DEFCONFIG_FILENAME="d12p_demo88-nand_rt-thread_helloworld_defconfig"
CONFIG_PRJ_CHIP="d12p"
CONFIG_PRJ_BOARD="demo88-nand"
CONFIG_PRJ_KERNEL="rt-thread"
CONFIG_PRJ_APP="helloworld"
CONFIG_AIC_USING_FS_IMAGE_0=y
CONFIG_AIC_USING_FS_IMAGE_TYPE_FATFS_FOR_0=y
CONFIG_AIC_FS_IMAGE_DIR_0="rodata/"
CONFIG_AIC_FS_IMAGE_NAME_0="rodata.fatfs"
CONFIG_AIC_USING_FS_IMAGE_1=y
CONFIG_AIC_USING_FS_IMAGE_TYPE_FATFS_FOR_1=y
CONFIG_AIC_FS_IMAGE_DIR_1="data"
CONFIG_AIC_FS_IMAGE_NAME_1="data.fatfs"
CONFIG_LVGL_V_9=y
CONFIG_AIC_LVGL_DEMO=y
CONFIG_AIC_LVGL_DEMO_HUB_DEMO=y
CONFIG_AIC_USING_UART0=y
CONFIG_AIC_USING_UART1=y
CONFIG_AIC_CLK_UART1_FREQ=60000000
CONFIG_AIC_USING_I2C1=y
CONFIG_AIC_USING_QSPI0=y
CONFIG_AIC_QSPI0_DEVICE_SPINAND=y
CONFIG_AIC_USING_SDMC0=y
# CONFIG_AIC_USING_SDMC1 is not set
CONFIG_AIC_SDMC_IRQ_MODE=y
CONFIG_AIC_SDMC0_SMP_PHASE=1
CONFIG_AIC_USING_TSEN=y
CONFIG_AIC_USING_TSEN_CPU=y
CONFIG_AIC_USING_GPAI=y
CONFIG_AIC_USING_GPAI0=y
CONFIG_AIC_USING_GPAI7=y
CONFIG_AIC_GPAI0_MODE_SINGLE=y
CONFIG_AIC_GPAI7_MODE_SINGLE=y
CONFIG_DATA_ORDER_BGR=y
CONFIG_AICFB_RGB565=y
CONFIG_AIC_PAN_DISPLAY=y
CONFIG_AIC_PANEL_ENABLE_GPIO="PF.0"
CONFIG_AIC_USING_DVP=y
CONFIG_AIC_USING_AUDIO=y
CONFIG_AIC_AUDIO_PA_ENABLE_GPIO="PE.17"
CONFIG_AIC_AUDIO_SPK0_OUTPUT_DIFFERENTIAL=y
CONFIG_AIC_USING_DMA=y
CONFIG_AIC_USING_WRI=y
CONFIG_AIC_USING_RTC=y
CONFIG_AIC_USING_WDT=y
CONFIG_AIC_INTERRUPTSTACK_SIZE=4096
CONFIG_AIC_USING_CLK_OUT0=y
CONFIG_AIC_SYSCFG_LDO1X_ENABLE=y
CONFIG_RT_NAME_MAX=8
CONFIG_IDLE_THREAD_STACK_SIZE=1024
# CONFIG_RT_USING_TIMER_SOFT is not set
# CONFIG_RT_KSERVICE_USING_STDLIB is not set
# CONFIG_RT_DEBUG is not set
CONFIG_RT_MEMHEAP_BSET_MODE=y
CONFIG_RT_USING_MEMHEAP_AS_HEAP=y
# CONFIG_RT_USING_MEMHEAP_AUTO_BINDING is not set
CONFIG_RT_CONSOLE_DEVICE_NAME="uart0"
CONFIG_RT_USING_LEGACY=y
CONFIG_FINSH_USING_WORD_OPERATION=y
CONFIG_FINSH_USING_FUNC_EXT=y
CONFIG_RT_USING_DFS_MNTTABLE=y
CONFIG_RT_USING_DFS_ELMFAT=y
CONFIG_RT_USING_DFS_ROMFS=y
CONFIG_RT_MMCSD_STACK_SIZE=8192
CONFIG_RT_USING_TOUCH=y
CONFIG_RT_USING_POSIX_FS=y
CONFIG_RT_USING_ULOG=y
CONFIG_ULOG_OUTPUT_LVL_I=y
CONFIG_ULOG_TIME_USING_TIMESTAMP=y
CONFIG_ULOG_USING_FILTER=y
CONFIG_LPKG_USING_MHZ=y
CONFIG_AIC_MPP_PLAYER_INTERFACE=y
CONFIG_AIC_MPP_VIN=y
CONFIG_AIC_GPIO_IRQ_DRV_EN=y
CONFIG_AIC_NFTL_SUPPORT=y
CONFIG_AIC_USING_CAMERA=y
CONFIG_AIC_CAMERA_I2C_CHAN=1
CONFIG_AIC_CAMERA_RST_PIN="PE.12"
CONFIG_AIC_CAMERA_PWDN_PIN="PE.13"
CONFIG_AIC_I2S_CODEC_SELECT=y
# CONFIG_AIC_I2S_CODEC_TLV320 is not set
CONFIG_AIC_I2S_CODEC_JY6311=y
CONFIG_AIC_I2S_CODEC_JY6311_I2C="i2c1"
CONFIG_AIC_I2S_CODEC_PA_PIN="PE.17"
CONFIG_AIC_CMU_DRV_TEST=y
CONFIG_AIC_DISPLAY_TEST=y
CONFIG_AIC_WDT_DRV_TEST=y
```

## target/configs/d21x_demo132-nand_baremetal_bootloader_defconfig
```kconfig
CONFIG_PRJ_DEFCONFIG_FILENAME="d21x_demo132-nand_baremetal_bootloader_defconfig"
CONFIG_PRJ_CHIP="d21x"
CONFIG_PRJ_BOARD="demo132-nand"
CONFIG_PRJ_KERNEL="baremetal"
CONFIG_PRJ_APP="bootloader"
CONFIG_PRJ_CUSTOM_LDS="application/baremetal/bootloader/ldscript/d21x_bootloader_gcc.ld"
CONFIG_AIC_USING_UART4=y
# CONFIG_AIC_USING_USB1 is not set
CONFIG_AIC_USING_QSPI0=y
CONFIG_AIC_QSPI0_DEVICE_SPINAND=y
# CONFIG_AIC_USING_DE is not set
# CONFIG_AIC_USING_GE is not set
# CONFIG_AIC_USING_VE is not set
CONFIG_AIC_USING_DMA=y
CONFIG_AIC_USING_WRI=y
CONFIG_AIC_USING_RTC=y
CONFIG_AIC_USING_WDT=y
CONFIG_AIC_INTERRUPTSTACK_SIZE=8192
CONFIG_AIC_NORMALSTACK_SIZE=8192
CONFIG_AIC_BOOTLOADER_TEXT_SIZE=0x7FF00
CONFIG_AIC_BOOTLOADER_HEAP_SIZE=0x280000
CONFIG_AIC_BOOTLOADER_CONSOLE_UART=4
# CONFIG_AIC_BOOTLOADER_SPINOR_SUPPORT is not set
CONFIG_AICUPG_NAND_ARTINCHIP=y
CONFIG_AIC_BOOTLOADER_CMD_NAND_BOOT=y
# CONFIG_AIC_BOOTLOADER_CMD_MEM is not set
CONFIG_AIC_BOOTLOADER_CMD_PART=y
CONFIG_LPKG_CHERRYUSB_DEVICE_CLASS_AIC_SINGLE=y
# CONFIG_LPKG_MPP is not set
CONFIG_AIC_ENV_INTERFACE=y
CONFIG_SPI_NAND_GIGADEVICE=y
CONFIG_AIC_NFTL_SUPPORT=y
CONFIG_AIC_NFLT_USED_LIB=y
CONFIG_AIC_SPINAND_DRV_TEST=y
CONFIG_AIC_MTD_BARE_TEST=y
```
