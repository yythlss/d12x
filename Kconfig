## target/configs/d21x_demo132-nand_rt-thread_helloworld_defconfig
```kconfig
CONFIG_PRJ_DEFCONFIG_FILENAME="d21x_demo132-nand_rt-thread_helloworld_defconfig"
CONFIG_PRJ_CHIP="d21x"
CONFIG_PRJ_BOARD="demo132-nand"
CONFIG_PRJ_KERNEL="rt-thread"
CONFIG_PRJ_APP="helloworld"
CONFIG_AIC_USING_FS_IMAGE_0=y
CONFIG_AIC_USING_FS_IMAGE_TYPE_FATFS_FOR_0=y
CONFIG_AIC_FS_IMAGE_DIR_0="rodata/"
CONFIG_AIC_FS_IMAGE_NAME_0="rodata.fatfs"
CONFIG_AIC_USING_FS_IMAGE_1=y
CONFIG_AIC_USING_FS_IMAGE_TYPE_FATFS_FOR_1=y
CONFIG_AIC_FS_IMAGE_DIR_1="data/"
CONFIG_AIC_FS_IMAGE_NAME_1="data.fatfs"
CONFIG_LVGL_V_9=y
CONFIG_AIC_LVGL_DEMO=y
CONFIG_AIC_LVGL_DEMO_HUB_DEMO=y
CONFIG_LV_COLOR_DEPTH=16
CONFIG_LV_CACHE_IMG_NUM=20
CONFIG_AIC_USING_UART1=y
CONFIG_AIC_USING_UART4=y
CONFIG_AIC_USING_I2C3=y
CONFIG_AIC_USING_HRTIMER0=y
# CONFIG_AIC_USING_USB1 is not set
CONFIG_AIC_USING_QSPI0=y
CONFIG_AIC_QSPI0_DEVICE_SPINAND=y
# CONFIG_AIC_USING_SDMC1 is not set
CONFIG_AIC_USING_SDMC2=y
CONFIG_AIC_SDMC2_IS_SDIO=y
CONFIG_AIC_WIRELESS_LAN=y
CONFIG_AIC_WIRELESS_PWR_GPIO="PF.15"
CONFIG_AIC_WIFI_SDMC_ID=2
CONFIG_AIC_WLAN_AIC8800D40L=y
CONFIG_AIC_USING_TSEN=y
CONFIG_AIC_USING_TSEN_CPU=y
CONFIG_AIC_USING_TSEN_GPAI=y
CONFIG_AIC_DISP_LVDS=y
CONFIG_AIC_LVDS_LINK_0=y
CONFIG_AIC_PAN_DISPLAY=y
CONFIG_AIC_STARTUP_UI_SHOW=y
CONFIG_AIC_PANEL_ENABLE_GPIO="PC.6"
CONFIG_AIC_USING_AUDIO=y
CONFIG_AIC_AUDIO_EN_PIN_LOW=y
CONFIG_AIC_AUDIO_SPK_1=y
# CONFIG_AIC_AUDIO_DMIC is not set
CONFIG_AIC_AUDIO_AMIC=y
CONFIG_AIC_USING_DMA=y
CONFIG_AIC_USING_WRI=y
CONFIG_AIC_USING_RTC=y
CONFIG_AIC_USING_WDT=y
CONFIG_AIC_DRAM_CMA_SIZE=0x2000000
CONFIG_AIC_INTERRUPTSTACK_SIZE=4096
CONFIG_AIC_USING_SID=y
CONFIG_AIC_USING_CE=y
CONFIG_AIC_USING_MTOP=y
CONFIG_IDLE_THREAD_STACK_SIZE=2048
CONFIG_RT_TIMER_THREAD_PRIO=7
CONFIG_RT_TIMER_THREAD_STACK_SIZE=8192
# CONFIG_RT_KSERVICE_USING_STDLIB is not set
# CONFIG_RT_KPRINTF_USING_LONGLONG is not set
# CONFIG_RT_DEBUG is not set
CONFIG_RT_MEMHEAP_BSET_MODE=y
CONFIG_RT_USING_MEMHEAP_AS_HEAP=y
# CONFIG_RT_USING_MEMHEAP_AUTO_BINDING is not set
CONFIG_RT_USING_DEVICE_OPS=y
CONFIG_RT_CONSOLE_DEVICE_NAME="uart4"
CONFIG_RT_MAIN_THREAD_STACK_SIZE=4096
CONFIG_RT_USING_LEGACY=y
CONFIG_FINSH_USING_WORD_OPERATION=y
CONFIG_FINSH_USING_FUNC_EXT=y
CONFIG_FINSH_HISTORY_LINES=1
CONFIG_DFS_FILESYSTEMS_MAX=8
CONFIG_RT_USING_DFS_MNTTABLE=y
CONFIG_RT_USING_DFS_ELMFAT=y
CONFIG_RT_DFS_ELM_LFN_UNICODE_2=y
CONFIG_RT_DFS_ELM_USE_EXFAT=y
CONFIG_RT_DFS_ELM_DRIVES=4
CONFIG_RT_USING_DFS_DEVFS=y
CONFIG_RT_USING_DFS_ROMFS=y
CONFIG_RT_USING_SYSTEM_WORKQUEUE=y
CONFIG_RT_SYSTEM_WORKQUEUE_STACKSIZE=8192
CONFIG_RT_USING_CAN=y
CONFIG_RT_CAN_USING_HDR=y
CONFIG_RT_I2C_DEBUG=y
# CONFIG_RT_USING_I2C_BITOPS is not set
CONFIG_RT_USING_ADC=y
CONFIG_RT_USING_PM=y
CONFIG_PM_USING_CUSTOM_CONFIG=y
CONFIG_PM_ENABLE_SUSPEND_SLEEP_MODE=y
CONFIG_PM_ENABLE_THRESHOLD_SLEEP_MODE=y
CONFIG_RT_SDIO_STACK_SIZE=16384
CONFIG_RT_SDIO_THREAD_PRIORITY=5
CONFIG_RT_MMCSD_STACK_SIZE=8192
CONFIG_RT_USING_TOUCH=y
CONFIG_RT_TOUCH_PIN_IRQ=y
CONFIG_RT_HWCRYPTO_USING_AES=y
CONFIG_RT_HWCRYPTO_USING_AES_CBC=y
CONFIG_RT_HWCRYPTO_USING_MD5=y
CONFIG_RT_HWCRYPTO_USING_SHA1=y
CONFIG_RT_HWCRYPTO_USING_SHA2=y
CONFIG_RT_HWCRYPTO_USING_SHA2_224=y
CONFIG_RT_HWCRYPTO_USING_SHA2_384=y
CONFIG_RT_HWCRYPTO_USING_SHA2_512=y
CONFIG_RT_USING_WIFI=y
CONFIG_RT_WLAN_WORKQUEUE_THREAD_SIZE=8192
CONFIG_RT_WLAN_DEBUG=y
CONFIG_RT_WLAN_CMD_DEBUG=y
CONFIG_RT_USING_POSIX_FS=y
CONFIG_RT_USING_NETDEV=y
CONFIG_RT_LWIP_TCPTHREAD_PRIORITY=3
CONFIG_RT_LWIP_TCPTHREAD_STACKSIZE=8192
CONFIG_RT_LWIP_REASSEMBLY_FRAG=y
CONFIG_RT_LWIP_NETIF_LOOPBACK=y
CONFIG_RT_USING_ULOG=y
CONFIG_ULOG_OUTPUT_LVL_I=y
CONFIG_ULOG_TIME_USING_TIMESTAMP=y
CONFIG_ULOG_USING_FILTER=y
CONFIG_LPKG_USING_BONNIE=y
CONFIG_LPKG_USING_CPU_USAGE=y
CONFIG_AIC_MPP_PLAYER_INTERFACE=y
CONFIG_AIC_GPIO_IRQ_DRV_EN=y
CONFIG_SPI_NAND_GIGADEVICE=y
CONFIG_AIC_NFTL_SUPPORT=y
CONFIG_AIC_NFLT_USED_LIB=y
CONFIG_AIC_USING_TOUCH=y
CONFIG_AIC_CMU_DRV_TEST=y
CONFIG_AIC_GPIO_DRV_TEST=y
CONFIG_AIC_DMA_DRV_TEST=y
CONFIG_AIC_RTC_DRV_TEST=y
CONFIG_AIC_HRTIMER_DRV_TEST=y
CONFIG_AIC_AUDIO_DRV_TEST=y
CONFIG_AIC_TSEN_TEST=y
```

## target/d12p/common/Kconfig.wlan_v10
```kconfig
menu "WLAN Configuration"

if !KERNEL_BAREMETAL

menuconfig AIC_WIRELESS_LAN
        bool "Using Wireless LAN"
        default n

if AIC_WIRELESS_LAN
    source "bsp/peripheral/wireless/Kconfig"
endif

endif
endmenu
```

## target/d12p/common/Kconfig.wlan_v11
```kconfig
menu "WLAN Configuration"

if !KERNEL_BAREMETAL

menuconfig AIC_WIRELESS_LAN
        bool "Using Wireless LAN"
        default n

if AIC_WIRELESS_LAN
    config AIC_WLAN_AIC8800D40L
        bool
        default y
        select LPKG_USING_MBEDTLS

    config AIC_WIRELESS_PWR_GPIO
        string
        default "PE.20"

    config AIC_WIRELESS_BT_PWR_GPIO
        string
        default "PE.18"

    config AIC_WIRELESS_WIFI_WK_HOST_GPIO
        string
        default "PE.19"

    config AIC_WIFI_SDMC_ID
        int
        default 1

    config CHIP_SELECT_AIC8800DL
        bool
        default y

    config CONFIG_AIC8800_VRF_DCDC_MODE
        bool
        default y

    choice
        prompt "Select wifi work mode"
        default CONFIG_AIC8800_NORMAL_MODE
        config CONFIG_AIC8800_NORMAL_MODE
            bool "normal mode"
        config CONFIG_AIC8800_RFTEST_MODE
            bool "rftest mode"
        config CONFIG_AIC8800_FTTEST_MODE
            bool "fttest mode"
    endchoice

    config CONFIG_AIC8800_MAC_USE_CHIP_ID
        bool "enable wifi mac use chip id"
        default n
        select AIC_USING_SID
        select AIC_MAC_CHIPID_DRV

    config CONFIG_AIC8800_BT_SUPPORT
        bool "enable BT support"
        default n

    config AIC_DEV_AIC8800_DEBUG_LOG
        bool "enable wifi debug messages"
        default n

    config AIC_WIRELESS_DELAY_POWER_ON
        int "wireless delay power on time (seconds)"
        default 0
endif

endif
endmenu
```
